## sdkconfig.defaults
```kconfig
# Rust often needs a bit of an extra main task stack size compared to C (the default is 3K)
CONFIG_ESP_MAIN_TASK_STACK_SIZE=8000

# Use this to set FreeRTOS kernel tick frequency to 1000 Hz (100 Hz by default).
# This allows to use 1 ms granuality for thread sleeps (10 ms by default).
#CONFIG_FREERTOS_HZ=1000

# Workaround for https://github.com/espressif/esp-idf/issues/7631
#CONFIG_MBEDTLS_CERTIFICATE_BUNDLE=n
#CONFIG_MBEDTLS_CERTIFICATE_BUNDLE_DEFAULT_FULL=n

# Disable PMP? https://docs.espressif.com/projects/esp-idf/en/latest/esp32c3/api-reference/kconfig.html#config-bootloader-region-protection-enable
CONFIG_BOOTLOADER_REGION_PROTECTION_ENABLE=N
# Maybe this one? I had high hopes...
# And the docs do suggest it works: https://docs.espressif.com/projects/esp-idf/en/v5.1.4/esp32c3/api-guides/fatal-errors.html#memory-protection-fault
CONFIG_ESP_SYSTEM_MEMPROT_FEATURE=no
CONFIG_ESP_SYSTEM_MEMPROT_FEATURE=N
# try more
CONFIG_ESP_SYSTEM_PMP_IDRAM_SPLIT=N
CONFIG_ESP_SYSTEM_MEMPROT_FEATURE_LOCK=N
# also no but flash nothing in early memory regions....
#
#
#do we even look at this file????
#maybe trigger error?
#need cargo clean... No error tho....
#CONFIG_ESP_SYSTEM_PANIC_PRINT_HALT=y

# also not
CONFIG_COMPILER_STACK_CHECK_MODE_NONE=y
# Prolly not:
CONFIG_FATFS_FS_LOCK=0
```
